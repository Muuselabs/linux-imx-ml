## arch/mips/configs/ml-j2000_defconfig
```kconfig
# CONFIG_ALLOW_DEV_COREDUMP is not set
CONFIG_BLK_CGROUP_IOLATENCY=y
CONFIG_BLK_CGROUP=y
# CONFIG_BLK_DEBUG_FS is not set
# CONFIG_BLK_DEV_BSG is not set
CONFIG_BLK_DEV_SD=m
CONFIG_BLK_DEV_THROTTLING=y
CONFIG_CC_OPTIMIZE_FOR_SIZE=y
CONFIG_CFS_BANDWIDTH=y
CONFIG_CGROUP_CPUACCT=y
CONFIG_CGROUP_SCHED=y
CONFIG_CGROUPS=y
CONFIG_CMDLINE_BOOL=y
CONFIG_CMDLINE="earlycon clk_ignore_unused"
# CONFIG_COMPAT_BRK is not set
CONFIG_CONFIGFS_FS=y
CONFIG_CONSOLE_LOGLEVEL_DEFAULT=15
CONFIG_CONSOLE_LOGLEVEL_QUIET=15
# CONFIG_CONSOLE_TRANSLATIONS is not set
# CONFIG_CORE_DUMP_DEFAULT_ELF_HEADERS is not set
CONFIG_CRC7=m
CONFIG_CRC_ITU_T=m
# CONFIG_CRYPTO_HW is not set
# CONFIG_CRYPTO_MANAGER_DISABLE_TESTS is not set
CONFIG_DEBUG_FS=y
# CONFIG_DEBUG_MISC is not set
# CONFIG_DEBUG_PREEMPT is not set
CONFIG_DEBUG_SECTION_MISMATCH=y
CONFIG_DEFAULT_HUNG_TASK_TIMEOUT=20
CONFIG_DEVTMPFS=y
CONFIG_DMA_JZ4780=y
# CONFIG_DNOTIFY is not set
CONFIG_EMBEDDED=y
# CONFIG_ETHERNET is not set
# CONFIG_ETHTOOL_NETLINK is not set
CONFIG_EXT4_FS=y
CONFIG_FAT_DEFAULT_UTF8=y
# CONFIG_FTRACE is not set
# CONFIG_FW_LOADER is not set
CONFIG_GPIOLIB_FASTPATH_LIMIT=32
# CONFIG_HID is not set
CONFIG_HIGH_RES_TIMERS=y
# CONFIG_HWMON is not set
# CONFIG_HW_RANDOM is not set
CONFIG_HZ_1000=y
CONFIG_I2C_CHARDEV=y
# CONFIG_I2C_COMPAT is not set
CONFIG_I2C_JZ4780=y
CONFIG_I2C=y
CONFIG_INET=y
CONFIG_INGENIC_OST=y
CONFIG_INPUT_EVDEV=y
# CONFIG_INPUT_MOUSE is not set
# CONFIG_IOMMU_SUPPORT is not set
CONFIG_IP_MULTICAST=y
# CONFIG_IPV6 is not set
CONFIG_JZ4740_WDT=y
CONFIG_JZ4770_PHY=y
# CONFIG_KALLSYMS is not set
# CONFIG_KEYBOARD_ATKBD is not set
CONFIG_KEYBOARD_GPIO=y
# CONFIG_LDISC_AUTOLOAD is not set
# CONFIG_LEGACY_PTYS is not set
CONFIG_LOG_BUF_SHIFT=14
CONFIG_MACH_INGENIC=y
CONFIG_MAGIC_SYSRQ=y
CONFIG_MEMCG_SWAP=y
CONFIG_MEMCG=y
CONFIG_MESSAGE_LOGLEVEL_DEFAULT=7
# CONFIG_MISC_FILESYSTEMS is not set
CONFIG_ML_J2000=y
CONFIG_MMC_X1000_DMA=y
CONFIG_MMC=y
CONFIG_MODULES=y
CONFIG_MODULE_UNLOAD=y
# CONFIG_MQ_IOSCHED_DEADLINE is not set
# CONFIG_MQ_IOSCHED_KYBER is not set
CONFIG_NET_CLS_CGROUP=y
# CONFIG_NET_CORE is not set
CONFIG_NETDEVICES=y
CONFIG_NET_SCH_CBQ=y
CONFIG_NET_SCHED=y
# CONFIG_NETWORK_FILESYSTEMS is not set
CONFIG_NET=y
CONFIG_NLS_CODEPAGE_437=m
CONFIG_NLS_ISO8859_1=m
CONFIG_NO_HZ_IDLE=y
CONFIG_PACKET=y
CONFIG_PANIC_ON_OOPS=y
CONFIG_PANIC_TIMEOUT=60
CONFIG_PREEMPT=y
CONFIG_PRINTK_SAFE_LOG_BUF_SHIFT=12
CONFIG_PRINTK_TIME=y
CONFIG_PROC_CHILDREN=y
# CONFIG_PWRSEQ_EMMC is not set
# CONFIG_RCU_TRACE is not set
# CONFIG_RSEQ is not set
CONFIG_RTC_CLASS=y
CONFIG_RTC_DRV_JZ4740=y
# CONFIG_RTC_HCTOSYS is not set
# CONFIG_RTC_INTF_DEV is not set
# CONFIG_RTC_INTF_PROC is not set
# CONFIG_RTC_INTF_SYSFS is not set
# CONFIG_RTC_NVMEM is not set
# CONFIG_RTC_SYSTOHC is not set
CONFIG_RT_GROUP_SCHED=y
# CONFIG_RUNTIME_TESTING_MENU is not set
CONFIG_SCHEDSTATS=y
# CONFIG_SCSI_LOWLEVEL is not set
CONFIG_SCSI=m
# CONFIG_SCSI_PROC_FS is not set
# CONFIG_SECCOMP is not set
CONFIG_SERIAL_8250_CONSOLE=y
# CONFIG_SERIAL_8250_DEPRECATED_OPTIONS is not set
CONFIG_SERIAL_8250_INGENIC=y
CONFIG_SERIAL_8250_NR_UARTS=3
CONFIG_SERIAL_8250_RUNTIME_UARTS=3
CONFIG_SERIAL_8250=y
CONFIG_SERIAL_OF_PLATFORM=y
# CONFIG_SERIO is not set
CONFIG_SLAB=y
CONFIG_SND_ASOC_INGENIC=y
# CONFIG_SND_DRIVERS is not set
# CONFIG_SND_MIPS is not set
# CONFIG_SND_PROC_FS is not set
CONFIG_SND_SOC=y
# CONFIG_SND_SUPPORT_OLD_API is not set
# CONFIG_SND_USB is not set
CONFIG_SND=y
CONFIG_SOFTLOCKUP_DETECTOR=y
CONFIG_SOUND=y
# CONFIG_STACKPROTECTOR is not set
CONFIG_STACKTRACE=y
CONFIG_STRIP_ASM_SYMS=y
# CONFIG_SUSPEND is not set
# CONFIG_SYMBOLIC_ERRNAME is not set
CONFIG_SYSVIPC=y
CONFIG_TMPFS=y
CONFIG_UEVENT_HELPER_PATH="/sbin/hotplug"
CONFIG_UEVENT_HELPER=y
CONFIG_UNIX=y
CONFIG_USB_AUDIO=m
CONFIG_USB_CDC_COMPOSITE=m
CONFIG_USB_CONFIGFS_ACM=y
CONFIG_USB_CONFIGFS_ECM=y
CONFIG_USB_CONFIGFS_F_FS=y
CONFIG_USB_CONFIGFS_F_HID=y
CONFIG_USB_CONFIGFS_F_LB_SS=y
CONFIG_USB_CONFIGFS_F_UAC1=y
CONFIG_USB_CONFIGFS_F_UAC2=y
CONFIG_USB_CONFIGFS=m
CONFIG_USB_CONFIGFS_MASS_STORAGE=y
CONFIG_USB_CONFIGFS_OBEX=y
CONFIG_USB_CONFIGFS_SERIAL=y
CONFIG_USB_DWC2=m
CONFIG_USB_ETH=m
CONFIG_USB_FUNCTIONFS=m
CONFIG_USB_G_ACM_MS=m
CONFIG_USB_GADGETFS=m
CONFIG_USB_GADGET=m
CONFIG_USB_G_HID=m
CONFIG_USB_G_MULTI_CDC=y
CONFIG_USB_G_MULTI=m
CONFIG_USB_G_NCM=m
CONFIG_USB_G_SERIAL=m
# CONFIG_USB_HID is not set
CONFIG_USB=m
CONFIG_USB_MASS_STORAGE=m
# CONFIG_USB_NET_DRIVERS is not set
CONFIG_USB_RAW_GADGET=m
CONFIG_USB_ROLE_SWITCH=m
CONFIG_USB_STORAGE=m
CONFIG_U_SERIAL_CONSOLE=y
CONFIG_VFAT_FS=m
# CONFIG_VGA_CONSOLE is not set
# CONFIG_VHOST_MENU is not set
# CONFIG_VIRTIO_MENU is not set
# CONFIG_VM_EVENT_COUNTERS is not set
CONFIG_WATCHDOG=y
# CONFIG_WIRELESS is not set
# CONFIG_WLAN is not set
CONFIG_WQ_WATCHDOG=y
```

## drivers/clk/ingenic/Kconfig
```kconfig
config COMMON_CLK_INGENIC
	bool
	depends on MACH_XBURST || MACH_XBURST2
	select MFD_SYSCON
	select COMMON_CLK

config CLK_X1000
	bool
	depends on SOC_X1000
	select COMMON_CLK_INGENIC
	help
	  build the ingenic x1000 soc clock driver.
config CLK_X2000
	bool
	depends on SOC_X2000
	select COMMON_CLK_INGENIC
	help
	  build the ingenic x2000 soc clock driver.
```

## drivers/muuselabs/Kconfig
```kconfig
#
# Muuselabs custom drivers
#

menu "Muuselabs drivers"

config MUUSELABS
	bool "Muuselabs additional drivers"
	help
	  Say Y here if you want to compile additional drivers
	  for Muuselabs systems

if MUUSELABS

config ML_IMX6ULL_ADDON
	tristate "Muuselabs IMX6ULL addon driver"
	help
	  Say Y here to compile the Muuselabs IMX6ULL
	  add-on driver.

endif # MUUSELABS

endmenu
```

## sound/soc/ingenic/Kconfig
```kconfig
menuconfig SND_ASOC_INGENIC
	tristate "ASoC support for Ingenic"
	depends on (MACH_X1000=y) && SND_SOC
	help
		Say 'Y' to enable Alsa drivers of xburst.

if SND_ASOC_INGENIC
config SND_ASOC_INGENIC_DEBUG
	bool "enable ingenic debug message"
	default n
config SND_ASOC_INGENIC_VERBOSE
	bool "enable ingenic verbose debug message"
	default n

choice
	prompt "Audio Version:"
	depends on SND_ASOC_INGENIC
config SND_ASOC_INGENIC_AS_V1
	bool "AudioSystem Version 1 For Ingenic SOCs"
	depends on MACH_X1000
	help
		Audio System Verison 1 for SOC X1000.
endchoice


if SND_ASOC_INGENIC_AS_V1

config SND_ASOC_INGENIC_X1000_BOARD
	tristate

config SND_ASOC_INGENIC_AIC
	tristate

config SND_ASOC_PDMA
	tristate
	select DMADEVICES
	select INGENIC_PDMAC
	select SND_SOC_GENERIC_DMAENGINE_PCM

config SND_ASOC_INGENIC_AIC_SPDIF
	tristate
	select SND_ASOC_INGENIC_AIC

config SND_ASOC_INGENIC_AIC_I2S
	tristate
	select SND_ASOC_INGENIC_AIC

config SND_ASOC_INGENIC_DMIC
	tristate

config SND_ASOC_INGENIC_PCM
	tristate

config SND_ASOC_INGENIC_ICDC_D3
	tristate
	select SND_ASOC_INGENIC_AIC
	select SND_ASOC_INGENIC_INCODEC

config SND_ASOC_INGENIC_DUMP_CODEC
	tristate

endif

menu "Ingenic Board Type Select"
choice
	prompt "SOC x1000 codec type select"
	depends on MACH_X1000
	depends on SND_ASOC_INGENIC_AS_V1
config SND_ASOC_INGENIC_HALLEY2_ICDC
	bool "Audio support for halley2 with internal codec"
	select SND_ASOC_PDMA
	select SND_ASOC_INGENIC_AIC_I2S
	select SND_ASOC_INGENIC_ICDC_D3
	select SND_ASOC_INGENIC_DMIC
	select SND_ASOC_INGENIC_PCM
	select SND_ASOC_INGENIC_DUMP_CODEC
	select SND_ASOC_INGENIC_X1000_BOARD

config SND_ASOC_INGENIC_HALLEY2_SPDIF
	bool "Audio support for halley2 with spdif"
	select SND_ASOC_PDMA
	select SND_ASOC_INGENIC_DMIC
	select SND_ASOC_INGENIC_PCM
	select SND_ASOC_INGENIC_DUMP_CODEC
	select SND_ASOC_INGENIC_X1000_BOARD
	select SND_ASOC_INGENIC_AIC_SPDIF
endchoice

endmenu

endif

source "sound/soc/ingenic/ecodec/Kconfig"
```
